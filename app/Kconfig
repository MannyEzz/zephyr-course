## app/Kconfig
```kconfig
#...............................Homework................................

menuconfig LED_SUBSYSTEM
    bool "LED Subsystem"
    default y

if LED_SUBSYSTEM

choice
    prompt "LED blink speed"
    default BLINK_SLEEP_1000MS

config BLINK_SLEEP_250MS
    bool "very Fast"

config BLINK_SLEEP_500MS
    bool "fast"

config BLINK_SLEEP_1000MS
    bool "medium"

config BLINK_SLEEP_2000MS
    bool "Slow"
endchoice

config BLINK_SLEEP_TIME_MS
    int
    default 250 if BLINK_SLEEP_250MS
    default 500 if BLINK_SLEEP_500MS
    default 1000 if BLINK_SLEEP_1000MS
    default 2000 if BLINK_SLEEP_2000MS
    default 0

menuconfig ADVANCE_SETTING
    bool "LED Advance Settings"
    default y
if ADVANCE_SETTING

config LED_BRIGHTNESS
    int "LED brightness (0-100)"
    range 0 100
    default 100

config LED_FADE_DURATION
    int "LED fade duration (ms)"
    default 500

menu "Exper settings"
    visible if ADVANCE_SETTING

config LED_DEBUGGING
    bool "Enable LED Debugging"

config CUSTOM_BLINK_Pattern
    bool "Enable LED Debugging"

endmenu

endif
endif

#...............................practice 2................................
# choice
#     prompt "LED blink speed"
#     default BLINK_SLEEP_1000MS

# config BLINK_SLEEP_250MS
#     bool "Fast"

# config BLINK_SLEEP_1000MS
#     bool "Normal"

# config BLINK_SLEEP_2000MS
#     bool "Slow"

# endchoice

# config BLINK_SLEEP_TIME_MS
#     int
#     default 250 if BLINK_SLEEP_250MS
#     default 1000 if BLINK_SLEEP_1000MS
#     default 2000 if BLINK_SLEEP_2000MS
#     default 0

#...............................practice 1................................

#config BLINK_SLEEP_TIME_MS
#    int "LED blink interval (ms)"
#    default 1000
#    range 100 5000
#    help
#      Time between LED toogle in milliseconds

source "Kconfig.zephyr"
```
